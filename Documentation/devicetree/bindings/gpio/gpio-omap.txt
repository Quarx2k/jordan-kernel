## drivers/usb/ipchost/Kconfig
```kconfig
#
# USB IPC driver configuration
#

comment "NOTE: USB_IPC enables AP-BP data transfer"
	depends on USB

config USB_IPC
	tristate "USB IPC support"
	depends on USB
	---help---
	  Say Y here if you want to enable AP-BP data transfer.

	  To compile this driver as a module, choose M here: the
	  module will be called usb-ipc.

config USB_IPC_TEST
        tristate "USB IPC TEST support"
        depends on USB_IPC
        ---help---
          Say Y here if you want to build IPC test module.

          To compile this driver as a module, choose M here: the
          module will be called usb-ipc-test.

config IPC_USBHOST_DBG
	tristate "USB IPC and USBHOST Debug support"
	depends on USB_IPC
	---help---
	  Say Y here if you want to log IPC/USBHOST activities into memory
	  for debugging IPC/BP Panic issues. Log will be dumped by printk
	  when disconnect ocurrs.
```

## drivers/video/omap2/dsscomp/Kconfig
```kconfig
menuconfig DSSCOMP
        tristate "OMAP DSS Composition support (EXPERIMENTAL)"
        depends on OMAP2_DSS
	default y

        help
          Frame composition driver using OMAP DSS2.  Allows using all
	  DSS2 resources in a unified configuration.  Should not be used
	  together with other DSS2 devices, such as V4L2 or framebuffer.

config DSSCOMP_DEBUG_LOG
	bool "Log event timestamps in debugfs"
	default y
	depends on DEBUG_FS

	help
	  Takes timestamp for each callback and state transition, and
	  logs the last 128 entries (last few frames' worth) in a
	  log buffer.  This is a separate menuconfig in case this is
	  deemed an overhead.

config OMAP3_ISP_RESIZER_ON_720P_VIDEO
	bool "ISP resizer used  for 720p video in DSSCOMP in OMAP3 (EXPERIMENTAL)"
	depends on EXPERIMENTAL && VIDEO_OMAP34XX_ISP_RESIZER
	default n
	help
	  Use ISP resizer on video buffers instead of DSS resizer.
	  Could increase performance of playing 720p clip but,
	  have some issues when record 720p with camera.
```
