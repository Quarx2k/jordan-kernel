## Documentation/devicetree/bindings/gpio/gpio-omap.txt
```
OMAP GPIO controller bindings

Required properties:
- compatible:
  - "ti,omap2-gpio" for OMAP2 controllers
  - "ti,omap3-gpio" for OMAP3 controllers
  - "ti,omap4-gpio" for OMAP4 controllers
- gpio-controller : Marks the device node as a GPIO controller.
- #gpio-cells : Should be two.
  - first cell is the pin number
  - second cell is used to specify optional parameters (unused)
- interrupt-controller: Mark the device node as an interrupt controller.
- #interrupt-cells : Should be 2.
  The first cell is the GPIO number.
  The second cell is used to specify flags:
    bits[3:0] trigger type and level flags:
      1 = low-to-high edge triggered.
      2 = high-to-low edge triggered.
      4 = active high level-sensitive.
      8 = active low level-sensitive.

OMAP specific properties:
- ti,hwmods:		Name of the hwmod associated to the GPIO:
			"gpio<X>", <X> being the 1-based instance number
			from the HW spec.
- ti,gpio-always-on: 	Indicates if a GPIO bank is always powered and
			so will never lose its logic state.

OMAP3 specific properties
Offmode wkup allows translation of a wakeup event
from a single pad in a gpio bank to a wakeup + an interrupt.
This works around the loss of isr status during off mode for
gpio banks 2 through 6

-	offmode-wkup-isr:  The isr offset in the bank
-	offmode-wkup-pad:  The pad offset associated with this pin

Example:

gpio4: gpio4 {
    compatible = "ti,omap4-gpio";
    ti,hwmods = "gpio4";
    gpio-controller;
    #gpio-cells = <2>;
    interrupt-controller;
    #interrupt-cells = <2>;

    offmode-wkup-isr = <0x00000008>;
    offmode-wkup-pad = <0x008e>;
};
```

## Documentation/devicetree/bindings/mfd/tps65912.txt
```
TPS65910 Power Management Integrated Circuit

Required properties:
- compatible: "ti,tps65912"
- reg: I2C slave address or SPI CS
- tps_irq_gpio: GPIO number of interrupt pin
- regulators: This is the list of child nodes that specify the regulator
  initialization data for defined regulators. Not all regulators for the given
  device need to be present. The definition for each of these nodes is defined
  using the standard binding for regulators found at
  Documentation/devicetree/bindings/regulator/regulator.txt.
  The regulator is matched with the regulator-compatible.

  The valid regulator-compatible values are:
    DCDC1, DCDC2, DCSC3, DCDC4,
    LDO1, LDO2, LDO3, LDO4, LDO5, LDO6, LDO7, LDO8, LDO9, LDO10

- xxx-supply: Input voltage supply regulator.
  These entries are require if regulators are enabled for a device. Missing of these
  properties can cause the regulator registration fails.
  If some of input supply is powered through battery or always-on supply then
  also it is require to have these parameters with proper node handle of always
  on power supply.
    LDO1:  DCDC2 input
    LDO2:  DCDC2 input
    LDO4:  DCDC2 input
    LDO6:  DCDC2 input
    LDO7:  DCDC2 input
    LDO9:  DCDC3 input
    LDO10: DCDC2 input

Optional properties:

  - dcdc1_avs, dcdc2_avs, dcdc3_avs, dcdc4_avs: set switcher to AVS mode
  - powerkey_up_irq, powerkey_up_irq: Interrupt bit generates a key up/down event
  - powerkey_code: keycode to be sent for key event

Example:

	tps65912 {

		compatible = "ti,tps65912";
		reg = <0>; /* CS 0 */
		spi-max-frequency = <1000000>;
		spi-cs-high;

		register-init-data = <
			0x2d 0x88 /* DISCHARGE1: Enable LDO4, LDO8 */
		>;

		dcdc1_avs;
		dcdc4_avs;

		tps_irq_gpio = <0>;

		powerkey_up_irq = <10>;		/* TPS65912_IRQ_GPIO3_R the key down */
		powerkey_down_irq = <11>;	/* TPS65912_IRQ_GPIO3_F the key up */
		powerkey_code = <116>;		/* power key code for android*/

		regulators {
			#address-cells = <1>;
			#size-cells = <0>;

			sw1_iva_reg: regulator@0 {
				reg = <0>;
				regulator-compatible = "DCDC1";
				regulator-name = "DCDC1";
				regulator-min-microvolt = <500000>;
				regulator-max-microvolt = <1287500>;
				regulator-boot-on;
			};

			sw2_reg: regulator@1 {
				reg = <1>;
				regulator-compatible = "DCDC2";
				regulator-name = "DCDC2";
				regulator-min-microvolt = <3000000>;
				regulator-max-microvolt = <3000000>;
				regulator-boot-on;
				regulator-always-on;
			};

			sw3_reg: regulator@2 {
				reg = <2>;
				regulator-compatible = "DCDC3";
				regulator-name = "DCDC3";
				regulator-min-microvolt = <1875000>;
				regulator-max-microvolt = <1875000>;
				regulator-boot-on;
				regulator-always-on;
			};

			sw4_core_reg: regulator@3 {
				reg = <3>;
				regulator-compatible = "DCDC4";
				regulator-name = "DCDC4";
				regulator-min-microvolt = <500000>;
				regulator-max-microvolt = <1287500>;
				regulator-boot-on;
			};

			ldo1_reg: regulator@4 {
				reg = <4>;
				regulator-compatible = "LDO1";
				regulator-name = "LDO1";
				regulator-min-microvolt = <1200000>;
				regulator-max-microvolt = <1200000>;
			};

			ldo2_reg: regulator@5 {
				reg = <5>;
				regulator-compatible = "LDO2";
				regulator-name = "LDO2";
				regulator-min-microvolt = <1700000>;
				regulator-max-microvolt = <1700000>;
			};

			ldo3_reg: regulator@6 {
				reg = <6>;
				regulator-compatible = "LDO3";
				regulator-name = "LDO3";
				regulator-min-microvolt = <2950000>;
				regulator-max-microvolt = <2950000>;
			};

			ldo4_reg: regulator@7 {
				reg = <7>;
				regulator-compatible = "LDO4";
				regulator-name = "LDO4";
				regulator-min-microvolt = <1800000>;
				regulator-max-microvolt = <1800000>;
				regulator-always-on;
			};

			ldo5_reg: regulator@8 {
				reg = <8>;
				regulator-compatible = "LDO5";
				regulator-name = "LDO5";
				regulator-min-microvolt = <2800000>;
				regulator-max-microvolt = <2800000>;
			};

			ldo6_reg: regulator@9 {
				reg = <9>;
				regulator-compatible = "LDO6";
				regulator-name = "LDO6";
				regulator-min-microvolt = <2300000>;
				regulator-max-microvolt = <2300000>;
			};

			ldo7_reg: regulator@10 {
				reg = <10>;
				regulator-compatible = "LDO7";
				regulator-name = "LDO7";
				regulator-min-microvolt = <2850000>;
				regulator-max-microvolt = <2850000>;
			};

			ldo8_reg: regulator@11 {
				reg = <11>;
				regulator-compatible = "LDO8";
				regulator-name = "LDO8";
				regulator-min-microvolt = <2800000>;
				regulator-max-microvolt = <2800000>;
				regulator-boot-on;
				regulator-always-on;
			};

			ldo9_reg: regulator@12 {
				reg = <12>;
				regulator-compatible = "LDO9";
				regulator-name = "LDO9";
				regulator-min-microvolt = <1700000>;
				regulator-max-microvolt = <1700000>;
			};

			ldo10_reg: regulator@13 {
				reg = <13>;
				regulator-compatible = "LDO10";
				regulator-name = "LDO10";
				regulator-min-microvolt = <2500000>;
				regulator-max-microvolt = <2500000>;
				regulator-always-on;
			};
		};
	};
```

## Documentation/devicetree/bindings/power/omap-prm-voltsetup.txt
```
PRM Voltage setup driver for Texas Instruments OMAP SoCs
It is helper driver for voltage controller and allows to customize voltage
setup time, PMIC voltage control hardware interface and clock source timing.

Required Properties:
- compatible: Should be :
  "ti,omap3-glbl-prm" - for OMAP3 family of devices
- reg: Address and length of the register set for the device. It contains
  the information of registers in the same order as described by reg-names
- reg-names: Should contain the reg names
- "base-address" contains base address of PRM global registers
- sys_clk: name of system clock (SYS_CLK)
- clksetup_time: TCXO stabilization time in micro seconds

Optional Properties:
- autoextclkmode: allows to control the external clock request (CLKREQ) and
  the oscillator. Values are used according with PRM_CLKSRC_CTRL register
  description in OMAP TRM.
- sys_off_mode: bool value selects the mode used to send OFF command. If present
  (true) sys_off_mode pin will be used, otherwise (false) I2C will be used.
- auto_off: bool vlaue enables/disables OFF command over I2C and assertion
  sys_off_mode signal.
- auto_retention: bool vlaue enables/disables RETENTION command over I2C and
  assertion CLQ_REQ signal.
- offmodesetup_time: voltage setup time in micro seconds when the device exits
  the off mode. It used only if sys_off_mode is true. If this value is not
  defined, then time is calculated based on PMIC slew rate and voltage level
  will be used. Claculated time is used also if value in device tree less then
  calculated.

Example:
glbl_prm: glbl_prm@48307250 {
	compatible = "ti,omap3-glbl-prm";
	reg = <0x48307250 0x60>;
	reg-names = "base-address";
	sys_off_mode;
	auto_off;
	auto_retention;
	autoextclkmode = <2>;
	clksetup_time = <1000>;
	sys_clk = "osc_sys_ck";
};
```

## Documentation/devicetree/bindings/power/omap-vc.txt
```
Voltage Controller driver for Texas Instruments OMAP SoCs

Voltage Controller Properties:
The following are the properties of the voltage controller node
Required Properties:
- compatible: Should be one of:
  - "ti,omap3-vc" - for OMAP3 family of devices
  - "ti,omap4-vc" - for OMAP4 family of devices
  - "ti,omap5-vc" - for OMAP5 family of devices
- reg: Address and length of the register set for the device. It contains
  the information of registers in the same order as described by reg-names
- reg-names: Should contain the reg names
  - "base-address"	- contains base address of VC module
- clocks: should point to the clock node used by VC module, usually sysclk
- ti,i2c-clk-scl-low: is mandatory if ti,i2c-pad-load is not used. contains
  hex to represent timing for slow I2C phase low clock time.
- ti,i2c-clk-scl-high: is mandatory if ti,i2c-pad-load is not used. contains
  hex to represent timing for slow I2C phase high clock time.
- ti,i2c-clk-hsscl-low: is mandatory if ti,i2c-pad-load is not used and
  ti,i2c-high-speed is used, contains hex to represent timing for high speed I2C
  phase low clock time.
- ti,i2c-clk-hsscl-high: is mandatory if ti,i2c-pad-load is not used and
  ti,i2c-high-speed is used, contains hex to represent timing for high speed I2C
  phase high clock time.
- Must contain VC channel nodes which belong to the Voltage controller.

Optional Properties:
- ti,i2c-high-speed: bool to indicate if VC should operate in high speed I2C
  mode.
- ti,i2c-pad-load: if ti,i2c-high-speed, then this is optional to auto load
  pre-calculated I2C clock timing configuration. This is denoted in pico-farads.
- ti,i2c-pcb-length: if ti,i2c-pad-load, then this is optional to select the
  pre-calculated I2C clock timing configuration. default of '63' is used.
  This is denoted in millimeters.
- pinctrl: Most OMAP SoCs do not allow pinctrl option to select VC's I2C path.
  it is usually hardcoded by default. Define "default" pinctrl-0 as needed.

Voltage Controller Channel Properties:
The following are the properties of the voltage controller channel nodes
Required Properties:
- compatible: Should be one of:
  - ti,omap3-vc-channel-0 - Channel 0 on OMAP3 family of devices
  - ti,omap3-vc-channel-1 - Channel 1 on OMAP3 family of devices
  - ti,omap4-vc-channel-mpu - Channel MPU on OMAP4 family of devices
  - ti,omap4-vc-channel-iva - Channel IVA on OMAP4 family of devices
  - ti,omap4-vc-channel-core - Channel CORE on OMAP4 family of devices
  - ti,omap5-vc-channel-mpu - Channel MPU on OMAP5 family of devices
  - ti,omap5-vc-channel-mm - Channel MM on OMAP5 family of devices
  - ti,omap5-vc-channel-core - Channel CORE on OMAP5 family of devices
- ti,master-channel: bool to mark the "master channel". Only ONE channel is
  to be marked as master channel depending on SoC specification.

Optional Properties:
- ti,retention-micro-volts: retention voltage for the voltage controller in
  micro-volts
- ti,off-micro-volts: OFF mode voltage for the voltage controller in micro-volts
- ti,use-master-slave-addr: available only for a "non-master" channel. This
  indicates the the channel will use master channel's slave address. Usually
  used when the PMIC has the same slave address for all SMPSs.
- ti,use-master-voltage-reg-addr: available only for a "non-master" channel.
  channel will use voltage register of the master channel to send voltage
  commands - usually used in "ganged" voltage rail configuration - NOTE: this
  is useful only when doing voltage transitions alone and not using AVS.
- ti,use-master-command-reg-addr: available only for a "non-master" channel.
  channel will use command register of the master channel to send command
  values - usually used in "ganged" voltage rail configuration - NOTE: this
  is useful only when doing voltage transitions alone and not using AVS.
- ti,use-master-command-reg-val: available only for a "non-master" channel.
  channel will use command value of the master channel to send commands
  - usually used in "ganged" voltage rail configuration - NOTE: this
  is useful only when doing voltage transitions alone and not using AVS.

Example:
SoC file: (example from OMAP4)
vc: vc@0x4A307B88 {
		compatible = "ti,omap4-vc";
		clocks = <&sysclk_in>;
		reg = <0x4A307B88 0x40>;
		reg-names = "base-address";

		vc_mpu: vc_mpu {
			compatible = "ti,omap4-vc-channel-mpu";
			ti,master-channel;
			ti,retention-micro-volts = <750000>;
			ti,off-micro-volts = <0>;
		};

		vc_iva: vc_iva {
			compatible = "ti,omap4-vc-channel-iva";
			ti,retention-micro-volts = <750000>;
			ti,off-micro-volts = <0>;
		};

		vc_core: vc_core {
			compatible = "ti,omap4-vc-channel-core";
			ti,retention-micro-volts = <750000>;
			ti,off-micro-volts = <0>;
		};
	};
```

## Documentation/devicetree/bindings/power/omap-vp.txt
```
Voltage Controller driver for Texas Instruments OMAP SoCs

Voltage Controller Properties:
The following are the properties of the voltage controller node
Required Properties:
- compatible: Should be one of:
  - "ti,omap3-vp" - for OMAP3 family of devices
  - "ti,omap4-vp" - for OMAP4 family of devices
  - "ti,omap5-vp" - for OMAP5 family of devices
- reg: Address and length of the register set for the device. It contains
  the information of registers in the same order as described by reg-names
- reg-names: Should contain the reg names
  - "base-address"	- contains base address of VP module
  - "int-address"	- contains base address of interrupt register for VP module
- clocks: should point to the clock node used by VC module, usually sysclk
- ti,min-micro-volts - SoC supported min operational voltage in micro-volts
- ti,max-micro-volts - SoC supported max operational voltage in micro-volts
- ti,min-step-micro-volts - SoC supported min operational voltage steps in micro-volts
- ti,max-step-micro-volts - SoC supported max operational voltage steps in micro-volts
- ti,tranxdone-status-mask: Mask to the int-register to write-to-clear mask
	indicating VP has completed operation in sending command to Voltage Controller.
- ti,vc-channel - phandle to the Voltage Controller Channel device used by this Voltage
	Processor.
Example:
vp_mpu: vp@0x4a307b58 {
	compatible = "ti,omap4-vp";

	reg = <0x4a307b58 0x18>, <0x4A306014 0x4>;
	reg-names = "base-address", "int-address";
	ti,tranxdone-status-mask=<0x20>;

	clocks = <&sysclk_in>;

	ti,vc-channel = <&vc_mpu>;
	ti,min-step-micro-volts = <10000>;
	ti,max-step-micro-volts = <50000>;
	ti,min-micro-volts = <750000>;
	ti,max-micro-volts = <1410000>;
};
```
