## Documentation/devicetree/bindings/regulator/omap-pmic-regulator.txt
```
Generic Power Management IC(PMIC) Regulator for Texas Instruments OMAP SoCs

Required Properties:
- compatible: Should be one of:
  - "ti,omap-twl4030-vdd1" - TWL4030/5030/TPS65950 VDD1
  - "ti,omap-twl4030-vdd2" - TWL4030/5030/TPS65950 VDD2
  - "ti,omap-twl6030-vcore1" - TWL6030 VCORE1
  - "ti,omap-twl6030-vcore2" - TWL6030 VCORE2
  - "ti,omap-twl6030-vcore3" - TWL6030 VCORE3
  - "ti,omap-tps62361" - TPS62361 VSEL1
  - "ti,omap-twl6032-smps1" - TWL6032 SMPS1
  - "ti,omap-twl6032-smps2" - TWL6032 SMPS2
  - "ti,omap-twl6032-smps5" - TWL6032 SMPS5
  - "ti,omap-twl6035-smps1" - TWL6035/6037 in SMPS1, 12, 123 configuration
  - "ti,omap-twl6035-smps4" - TWL6035/6037 in SMPS4, 45 configuration
  - "ti,omap-twl6035-smps8" - TWL6035/6037 in SMPS8 configuration

Optional Properties:
- gpios: OF device-tree gpio specification - can be an array, will be setup
	in the order of definition and set to the flags.
- pinctrl: OF device-tree pinctrl definitions as needed (usually for the GPIOs)
- ti,boot-voltage-micro-volts - voltage in microvolts that bootloader is leaving
	over the PMIC at. This may be 'PMIC data manual configuration' if
	bootloader does not set an value, or appropritate value.


Example: Sample PMIC description
omap_tps62361: tps62361 {
	compatible = "ti,omap-tps62361";
};

/* Board Specific configuration */
&omap_tps62361 {
	pinctrl-names = "default";
	pinctrl-0 = <
		&tps62361_wkgpio_pins
	>;
	gpios = <&gpio1 7 1>;	/* gpio_wk7 */

	ti,boot-voltage-micro-volts=<1200000>;
};
```

## Documentation/devicetree/bindings/ti-pad_wkup.txt
```
OMAP3 pad wkup generator

Functionality to map omap pad wkup status to irq events;

Required properties:
- ti,pad_irq  Maps a pad offset to a IRQ
    on omap, the irqs are calculated as follows:
    for the 96 intc IRQs
       irq = 16 + irq_offset (from TRM sec 12.3.2)
    for a gpio IRQ (banks numbered 1 to 6
       irq = 16 + 96 + (gpio_bank - 1) * 32

		ti,pad_irq = <0x008e 171>, /* m4sensor hub */
		             <0x00e6 211>, /* touch */
		             <0x013c 252>, /* battery */
		             <0x0140 254>, /* USB */
		             <0x01a2 288>; /* gpio-charger */
```

## arch/arm/mach-omap2/Kconfig
```kconfig
comment "OMAP Core Type"
	depends on ARCH_OMAP2

config ARCH_OMAP24XX
	bool "OMAP24xx Based System"
	depends on ARCH_OMAP2

config ARCH_OMAP2420
	bool "OMAP2420 support"
	depends on ARCH_OMAP24XX
	select OMAP_DM_TIMER
	select ARCH_OMAP_OTG

config ARCH_OMAP2430
	bool "OMAP2430 support"
	depends on ARCH_OMAP24XX

config ARCH_OMAP34XX
	bool "OMAP34xx Based System"
	depends on ARCH_OMAP3
	select USB_ARCH_HAS_EHCI

config ARCH_OMAP3430
	bool "OMAP3430 support"
	depends on ARCH_OMAP3 && ARCH_OMAP34XX
	select ARCH_OMAP_OTG

comment "OMAP Board Type"
	depends on ARCH_OMAP2 || ARCH_OMAP3 || ARCH_OMAP4

config MACH_OMAP_GENERIC
	bool "Generic OMAP board"
	depends on ARCH_OMAP2 && ARCH_OMAP24XX

config WIFI_CONTROL_FUNC
        bool "Enable WiFi control function abstraction"
	depends on MACH_OMAP_ZOOM2 || MACH_SHOLES || MACH_MAPPHONE
        help
          Enables Power/Reset/Carddetect function abstraction

config TIWLAN_SDIO
	bool "TI WLAN Enhanced SDIO Contoller support"
	depends on MMC_OMAP || MMC_OMAP_MODULE || MMC_OMAP_HS || MMC_OMAP_HS_MODULE
	help
	   Say Y here if you want to be able to use TI's WLAN device using the
	   SDIO interface. If unsure, say N.

config TIWLAN_MMC_CONTROLLER
	int "MMC Controller number that TI WLAN chip is connected to"
	range 1 3
	depends on TIWLAN_SDIO || MMC_EMBEDDED_SDIO
	default "3"
	help
	  Choose the number of the MMC controller that TI WLAN chip is
	  connected to. TI WLAN has SDIO host controller that will control
	  this MMC port.

config MACH_MAPPHONE
	bool "Motorola Android Platform phone"
	depends on ARCH_OMAP3 && ARCH_OMAP34XX

config MAPPHONE_2NDBOOT
	bool "Motorola Android Platform phone 2nd-boot kernel modifications"
	depends on MACH_MAPPHONE

config MACH_OMAP_3430_ES3_ARM_ERRATA
	bool "OMAP 3430 ES3.x Cortex-A8 ARM Errata"
	default y if ARCH_OMAP3_HS
	select ARM_ERRATA_430973
	select ARM_ERRATA_621766
	select ARM_ERRATA_725233

config EMU_UART_DEBUG
	bool "Setting MiniUSB port as UART3 to debug kernel"
	default n
	help
	  This feature is specific for Motorola phone with CPCAP power IC.
	  If this option is selected, USB functionality is NOT available any more.

config DTC
	bool "Device tree support"
	default n
	help
	  Adds support for device tree alongside ATAG

config MAPPHONE_DTC
	bool "Motorola Android Platform device tree"
	depends on DTC && MACH_MAPPHONE
	default n
	help
	  Specific version of the device tree for Motorola Android Platform phone

config OMAP3_EXPORT_DIE_ID
       bool "Export DIE ID code under /proc/socinfo"
       depends on ARCH_OMAP3
       default n
       help
         Say Y here if you need DIE ID code to be exported via /proc/socinfo
         in production systems. You will need also to explicitly flag it by
         appending the "omap3_die_id" parameter to your boot command line.

config PM_DEEPSLEEP
	bool "instant on feature"
	default n
	help
	  if enabling this feature, when PM state is set to DEEPSLEEP, the kerne
	  ignore all key press except long press power key.

config OMAP3_OVERCLOCK
	bool "OMAP3 overclock"
	depends on ARCH_OMAP3 && ARCH_OMAP34XX
	default n
	help
	  Say Y to allow setting clock and voltage for MPU using procfs.
```

## drivers/dsp/bridge/Kconfig
```kconfig
#
# DSP Bridge Driver Support
#

menuconfig MPU_BRIDGE
	tristate "DSP Bridge driver"
	default n
	help
	  DSP/BIOS Bridge is designed for platforms that contain a GPP and
	  one or more attached DSPs.  The GPP is considered the master or
	  "host" processor, and the attached DSPs are processing resources
	  that can be utilized by applications and drivers running on the GPP.

config BRIDGE_DVFS
	bool "Enable Bridge Dynamic Voltage and Frequency Scaling (DVFS)"
	depends on MPU_BRIDGE && OMAP_PM_SRF
	default n
	help
	  DVFS allows DSP Bridge to initiate the operating point change to
	  scale the chip voltage and frequency in order to match the
	  performance and power consumption to the current processing
	  requirements.

config BRIDGE_MEMPOOL_SIZE
	hex "Physical memory pool size (Byte)"
	depends on MPU_BRIDGE
	default 0x600000
	help
	  Allocate specified size of memory at booting time to avoid allocation
	  failure under heavy memory fragmentation after some use time.

config BRIDGE_DEBUG
	bool "DSP Bridge Debug Support"
	depends on MPU_BRIDGE
	help
	  Say Y to enable Bridge debugging capabilities

config BRIDGE_RECOVERY
	bool "Recover from errors by reloading the dsp firmware from the kernel"
	depends on MPU_BRIDGE
	help
	  Allows the bridge driver to reload the bridge firmware on error.  The
	  alternative is to use the TI bridge daemon.

menu "Bridge Hacking"
	depends on MPU_BRIDGE

config BRIDGE_CHECK_ALIGN_128
	bool "Check buffers to be 128 byte aligned"
	depends on MPU_BRIDGE
	default n
	help
	  When the DSP processes data, the DSP cache controller loads 128-Byte
	  chunks (lines) from SDRAM and writes the data back in 128-Byte chunks.
	  If a DMM buffer does not start and end on a 128-Byte boundary, the data
	  preceding the start address (SA) from the 128-Byte boundary to the SA
	  and the data at addresses trailing the end address (EA) from the EA to
	  the next 128-Byte boundary will be loaded and written back as well.
	  This can lead to heap corruption. Say Y, to enforce the check for 128
	  byte alignment, buffers failing this check will be rejected.

comment "Bridge Notifications"
	depends on MPU_BRIDGE

config BRIDGE_NTFY_PWRERR
	bool "Notify DSP Power Error"
	depends on MPU_BRIDGE
	help
	  Enable notifications to registered clients on the event of power errror
	  trying to suspend bridge driver. Say Y, to signal this event as a fatal
	  error, this will require a bridge restart to recover.
endmenu
```

## drivers/gpu/pvr/Kconfig
```kconfig
config SGX_OMAP3630
	tristate "PowerVR SGX for OMAP3630"
	depends on ARCH_OMAP3
	help
	  Support for the PowerVR SGX 3D core with OMAP 3630.

config SGX_SYNC
	depends on SGX_OMAP3630 && SW_SYNC
	bool "Andorid soft-synchronization objects"
	default n
	help
	  Support  Android Frameworks Native Sync

choice
	prompt "PowerVR build type"
	default SGX_BUILD_RELEASE

config SGX_BUILD_RELEASE
	depends on SGX_OMAP3630
	bool "SGX RELEASE"
        help
          SGX Release Build.

config SGX_BUILD_DEBUG
	depends on SGX_OMAP3630
	bool "SGX DEBUG"
        help
          SGX Debug Build.

endchoice

config SGX_PDUMP
	depends on SGX_OMAP3630
	bool "PowerVR SGX Parameter Dump"
	default n
	help
	  This option enables the PDump (Parameter Dump) build to debug
	  the SGX driver. The user side of the driver must be built with
	  this option enabled as well.
```

## drivers/media/video/hp3a/Kconfig
```kconfig
# Kconfig for OMAP3 HP3A driver

config VIDEO_OMAP3_HP3A
	tristate "HP OMAP3 Imaging/3A driver"
	depends on VIDEO_V4L2
	---help---
	  This enables the use of the HP image processing for V4L2 camera.
```

## drivers/media/video/isp/Kconfig
```kconfig
# Kconfig for OMAP3 ISP driver

config VIDEO_OMAP34XX_ISP_PREVIEWER
	tristate "OMAP ISP Previewer"

config VIDEO_OMAP34XX_ISP_RESIZER
	tristate "OMAP ISP Resizer"
```

## drivers/media/video/oldisp/Kconfig
```kconfig
# Kconfig for OMAP3 ISP driver

config VIDEO_OLDOMAP34XX_ISP_PREVIEWER
	tristate "OMAP ISP Previewer"
	depends on !ARCH_OMAP3410

config VIDEO_OLDOMAP34XX_ISP_RESIZER
	tristate "OMAP ISP Resizer"
	depends on !ARCH_OMAP3410
```

## drivers/media/video/omap-vout/Kconfig
```kconfig
config VIDEO_OMAP_VIDEOOUT
	tristate "Video out driver"
	depends on VIDEO_DEV && VIDEO_V4L2 && OMAP2_DSS
	select VIDEOBUF_GEN

config VIDEO_OMAP_VIDEOOUT_BUFPOOL
	tristate "Video out driver buffer pool"
	depends on VIDEO_OMAP_VIDEOOUT
```

## drivers/misc/netmux/Kconfig
```kconfig
#
# Netmux configuration
#

menu "Motorola netmux driver"

config NETMUX_DRIVER
        tristate "Motorola netmux driver"
        default m

config DEBUG_NETMUX
        bool "Builds netmux proc logging Interface"
        default n

endmenu
```

## drivers/misc/netmux_linkdriver/Kconfig
```kconfig
#
# Netmux configuration
#

menu "Motorola netmux link driver"

config NETMUX_LINKDRIVER
        tristate "Motorola netmux link driver"
        default m

endmenu
```

## drivers/misc/netmux_linkdriver/usb/Kconfig
```kconfig
# Kconfig - Netmux Linkdriver configuration options
#
# Copyright 2008 Motorola, Inc.
#
# This program is free software; you can redistribute it and/or
# modify it under the terms of the GNU General Public License
# as published by the Free Software Foundation; either version 2
# of the License, or (at your option) any later version.
#
# This program is distributed in the hope that it will be useful,
# but WITHOUT ANY WARRANTY; without even the implied warranty of
# MERCHANTABILITY or FITNESS FOR A PARTICULAR PURPOSE.  See the
# GNU General Public License for more details.
#
# You should have received a copy of the GNU General Public License
# along with this program; if not, write to the Free Software
# Foundation, Inc., 59 Temple Place - Suite 330, Boston, MA  02111-1307, USA.
#

config NETMUX_LINKDRIVER_SOFTERROR
        boolean "Turn panics in the linkdriver to printks"
        default n
        help
                All invocations of panic in the netmux linkdriver will be
                replaced with printks.
```

## drivers/misc/sec/Kconfig
```kconfig
#
# Sec configuration
#

menu "Motorola sec driver"

config SEC_DRIVER
	tristate "Motorola sec driver"
	default m

endmenu
```

## drivers/misc/smc/Kconfig
```kconfig
menu "SMC Driver Support for OMAP3"
	depends on ARCH_OMAP3
config  SMC_DRIVER
	bool "SMC Driver for OMAP3"
	default n
	help
	  This option selects SMC driver for OMAP5 EMU/HS Devices.

config SMC_DRIVER_DEBUG_SUPPORT
	depends on SMC_DRIVER
	bool "Debug build"
	default n
	help
	  This option selects the debug build
endmenu
```

## drivers/misc/ts27010mux/Kconfig
```kconfig
#
# TS 27.010 configuration
#

menu "Motorola TS 27.010 Mux driver"

config MOT_FEAT_TS27010MUX
        tristate "Motorola TS 27.010 Mux driver"
        default n

endmenu
```

## drivers/net/wireless/wl12xx_sdio/Kconfig
```kconfig
menuconfig WL12XX_MENU
	tristate "TI wl12xx driver support"
	---help---
	  This will enable TI wl12xx driver support for the following chips:
	  wl1271, wl1273, wl1281 and wl1283.
	  The drivers make use of the mac80211 stack.

config WL12XX
	tristate "TI wl12xx support"
	depends on WL12XX_MENU && GENERIC_HARDIRQS
	depends on INET
	select FW_LOADER
	---help---
	  This module adds support for wireless adapters based on TI wl1271 and
	  TI wl1273 chipsets. This module does *not* include support for wl1251.
	  For wl1251 support, use the separate homonymous driver instead.

	  If you choose to build a module, it will be called wl12xx. Say N if
	  unsure.

config WL12XX_SPI
	tristate "TI wl12xx SPI support"
	depends on WL12XX && SPI_MASTER
	select CRC7
	---help---
	  This module adds support for the SPI interface of adapters using
	  TI wl12xx chipsets.  Select this if your platform is using
	  the SPI bus.

	  If you choose to build a module, it'll be called wl12xx_spi.
	  Say N if unsure.

config WL12XX_SDIO
	tristate "TI wl12xx SDIO support"
	depends on WL12XX && MMC
	---help---
	  This module adds support for the SDIO interface of adapters using
	  TI wl12xx chipsets.  Select this if your platform is using
	  the SDIO bus.

	  If you choose to build a module, it'll be called wl12xx_sdio.
	  Say N if unsure.

config WL12XX_PLATFORM_DATA
	bool
	default y

config NL80211_TESTMODE
	bool "nl80211 testmode command"
	depends on WL12XX_SDIO
	help
	  The nl80211 testmode command helps implementing things like
	  factory calibration or validation tools for wireless chips.

	  Select this option ONLY for kernels that are specifically
	  built for such purposes.

	  Debugging tools that are supposed to end up in the hands of
	  users should better be implemented with debugfs.

	  Say N.
```

## drivers/power/avs/Kconfig
```kconfig
menuconfig POWER_AVS
	bool "Adaptive Voltage Scaling class support"
	help
	  AVS is a power management technique which finely controls the
	  operating voltage of a device in order to optimize (i.e. reduce)
	  its power consumption.
	  At a given operating point the voltage is adapted depending on
	  static factors (chip manufacturing process) and dynamic factors
	  (temperature depending performance).
	  AVS is also called SmartReflex on OMAP devices.

	  Say Y here to enable Adaptive Voltage Scaling class support.

config POWER_TI_HARDWARE_VOLTAGE_CONTROL
	tristate "TI OMAP SoC Voltage Control support"
	depends on OF && ARCH_OMAP && REGULATOR_TI_OMAP_PMIC
	select REGMAP_MMIO
	help
	  Select this option to support Texas Instruments' custom Voltage
	  Processor + Voltage Controller data interface used in OMAP SoCs
	  to enable Adaptive Voltage Scaling(AVS) and Device Frequency and
	  Voltage Scaling(DVFS). This is a specific "write-only" interface
	  designed to interface with I2C based PMICs. These two subsystems
	  in OMAP do not exist independent of each other as they are
	  practically useless without each other.

	  Say Y here to enable TI OMAP SoC Voltage Control support.
```

## drivers/sim/Kconfig
```kconfig
config SIM
	bool "SIM support"
	default n
	help
	  Say Y here to enable SIM support.
```
