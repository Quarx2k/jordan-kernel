/*
 * Copyright (C) 2014 Motorola Mobility LLC
 *
 * This program is free software; you can redistribute it and/or modify
 * it under the terms of the GNU General Public License version 2 as
 * published by the Free Software Foundation.
 */
/dts-v1/;

/include/ "omap3-minnow.dtsi"

/ {
	mmi,revision = "p1";
	mmi,hwrev = <
		0x04   /* Minnow P1B portable */
	>;

	Display@0 {
		/* place holder for P1B display support */
	};

};
