/*
 * Copyright (C) 2014 Motorola Mobility LLC
 *
 * This program is free software; you can redistribute it and/or modify
 * it under the terms of the GNU General Public License version 2 as
 * published by the Free Software Foundation.
 */
/dts-v1/;

/include/ "omap3-minnow.dtsi"

/ {
	mmi,revision = "p1";
	mmi,hwrev = <
		0x05   /* Minnow P2A wing */
		0x06   /* Minnow P2A portable */
	>;

	Display@0 {
		gpio_vio_en = <&gpio2 10 0>;    /* VDDIO gpio-42 */
	};
};

&i2c1 {
	atmxt@4a {
		support-snowflake = <0>;
	};
};
